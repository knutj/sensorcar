/ {
	amba_pl: amba_pl {
		ranges;
		compatible = "simple-bus";
		#address-cells = <1>;
		#size-cells = <1>;
		PWM_0: PWM@43c00000 {
			compatible = "xlnx,PWM-2.0";
			xlnx,rable = <0>;
			xlnx,ip-name = "PWM";
			xlnx,pwm-axi-data-width = <32>;
			reg = <0x43c00000 0x10000>;
			clocks = <&clkc 15>;
			xlnx,edk-iptype = "PERIPHERAL";
			xlnx,polarity = "1";
			status = "okay";
			clock-names = "pwm_axi_aclk";
			xlnx,pwm-axi-addr-width = <7>;
			xlnx,name = "PWM_0";
			xlnx,num-pwm = <4>;
		};
	};
};
